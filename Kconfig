## Kconfig
```kconfig
# SPDX-FileCopyrightText: 2026 roolrz
# SPDX-License-Identifier: Apache-2.0

config SYSTEM_APP_FS_FAT_SYSTEM
    bool "fs-fat-system (/svc/fs-fat)"
    default y
    depends on SYSTEM_APP_FS_BACKEND_SYSTEM
    help
        Build and deploy hyper-fs-fat-system at /svc/fs-fat.
```
